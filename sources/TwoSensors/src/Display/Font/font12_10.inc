#include "Font.h"
const Font22 font12_10 = {
	12, 	10, {
/*0*/		{ 10, { 1023,	1023,	1023,	1023,	1023,	1023,	1023,	1023,	1023,	1023,	1023,	1023	} },	
/*1*/		{ 10, { 1021,	513,	513,	513,	513,	513,	513,	513,	513,	513,	513,	1021	} },	
/*2*/		{ 1, { 1,	1,	1,	1,	1,	1,	1,	1,	1,	1,	1,	1	} },	
/*3*/		{ 0, { 0,	0,	0,	0,	0,	0,	0,	0,	0,	0,	0,	0	} },	
/*4*/		{ 0, { 0,	0,	0,	0,	0,	0,	0,	0,	0,	0,	0,	0	} },	
/*5*/		{ 0, { 0,	0,	0,	0,	0,	0,	0,	0,	0,	0,	0,	0	} },	
/*6*/		{ 0, { 0,	0,	0,	0,	0,	0,	0,	0,	0,	0,	0,	0	} },	
/*7*/		{ 0, { 0,	0,	0,	0,	0,	0,	0,	0,	0,	0,	0,	0	} },	
/*8*/		{ 0, { 0,	0,	0,	0,	0,	0,	0,	0,	0,	0,	0,	0	} },	
/*9*/		{ 0, { 0,	0,	0,	0,	0,	0,	0,	0,	0,	0,	0,	0	} },	
/*10*/		{ 0, { 0,	0,	0,	0,	0,	0,	0,	0,	0,	0,	0,	0	} },	
/*11*/		{ 0, { 0,	0,	0,	0,	0,	0,	0,	0,	0,	0,	0,	0	} },	
/*12*/		{ 0, { 0,	0,	0,	0,	0,	0,	0,	0,	0,	0,	0,	0	} },	
/*13*/		{ 5, { 4,	14,	31,	4,	4,	31,	14,	4,	0,	0,	0,	0	} },	
/*14*/		{ 8, { 124,	130,	5,	9,	17,	1,	1,	130,	0,	0,	0,	0	} },	
/*15*/		{ 1, { 0,	0,	1,	1,	1,	1,	1,	0,	0,	0,	0,	0	} },	
/*16*/		{ 0, { 0,	0,	0,	0,	0,	0,	0,	0,	0,	0,	0,	0	} },	
/*17*/		{ 0, { 0,	0,	0,	0,	0,	0,	0,	0,	0,	0,	0,	0	} },	
/*18*/		{ 0, { 0,	0,	0,	0,	0,	0,	0,	0,	0,	0,	0,	0	} },	
/*19*/		{ 0, { 0,	0,	0,	0,	0,	0,	0,	0,	0,	0,	0,	0	} },	
/*20*/		{ 0, { 0,	0,	0,	0,	0,	0,	0,	0,	0,	0,	0,	0	} },	
/*21*/		{ 0, { 0,	0,	0,	0,	0,	0,	0,	0,	0,	0,	0,	0	} },	
/*22*/		{ 0, { 0,	0,	0,	0,	0,	0,	0,	0,	0,	0,	0,	0	} },	
/*23*/		{ 0, { 0,	0,	0,	0,	0,	0,	0,	0,	0,	0,	0,	0	} },	
/*24*/		{ 0, { 0,	0,	0,	0,	0,	0,	0,	0,	0,	0,	0,	0	} },	
/*25*/		{ 0, { 0,	0,	0,	0,	0,	0,	0,	0,	0,	0,	0,	0	} },	
/*26*/		{ 0, { 0,	0,	0,	0,	0,	0,	0,	0,	0,	0,	0,	0	} },	
/*27*/		{ 0, { 0,	0,	0,	0,	0,	0,	0,	0,	0,	0,	0,	0	} },	
/*28*/		{ 0, { 0,	0,	0,	0,	0,	0,	0,	0,	0,	0,	0,	0	} },	
/*29*/		{ 0, { 0,	0,	0,	0,	0,	0,	0,	0,	0,	0,	0,	0	} },	
/*30*/		{ 7, { 124,	0,	0,	0,	0,	0,	0,	0,	0,	0,	0,	0	} },	
/*31*/		{ 0, { 0,	0,	0,	0,	0,	0,	0,	0,	0,	0,	0,	0	} },	
/*32*/		{ 0, { 0,	0,	0,	0,	0,	0,	0,	0,	0,	0,	0,	0	} },	
/*33*/		{ 3, { 4,	4,	4,	4,	4,	0,	4,	0,	0,	0,	0,	0	} },	
/*34*/		{ 3, { 5,	5,	0,	0,	0,	0,	0,	0,	0,	0,	0,	0	} },	
/*35*/		{ 5, { 0,	10,	31,	10,	10,	31,	10,	0,	0,	0,	0,	0	} },	
/*36*/		{ 5, { 0,	4,	31,	5,	31,	20,	31,	4,	0,	0,	0,	0	} },	
/*37*/		{ 6, { 39,	37,	23,	16,	8,	8,	4,	4,	2,	58,	41,	57	} },	
/*38*/		{ 5, { 0,	4,	10,	4,	26,	9,	22,	0,	0,	0,	0,	0	} },	
/*39*/		{ 3, { 0,	4,	2,	0,	0,	0,	0,	0,	0,	0,	0,	0	} },	
/*40*/		{ 2, { 2,	2,	1,	1,	1,	2,	2,	0,	0,	0,	0,	0	} },	
/*41*/		{ 2, { 1,	1,	2,	2,	2,	1,	1,	0,	0,	0,	0,	0	} },	
/*42*/		{ 3, { 0,	0,	5,	2,	5,	0,	0,	0,	0,	0,	0,	0	} },	
/*43*/		{ 3, { 0,	0,	2,	7,	2,	0,	0,	0,	0,	0,	0,	0	} },	
/*44*/		{ 4, { 0,	0,	0,	0,	0,	8,	4,	0,	0,	0,	0,	0	} },	
/*45*/		{ 6, { 0,	0,	0,	0,	0,	63,	0,	0,	0,	0,	0,	0	} },	
/*46*/		{ 1, { 0,	0,	0,	0,	0,	0,	0,	0,	0,	0,	0,	1	} },	
/*47*/		{ 4, { 8,	8,	8,	4,	4,	4,	2,	2,	2,	1,	1,	1	} },	
/*48*/		{ 6, { 30,	33,	33,	33,	33,	33,	33,	33,	33,	33,	33,	30	} },	
/*49*/		{ 6, { 8,	12,	10,	8,	8,	8,	8,	8,	8,	8,	8,	62	} },	
/*50*/		{ 6, { 31,	32,	32,	32,	32,	30,	1,	1,	1,	1,	1,	62	} },	
/*51*/		{ 6, { 31,	32,	32,	32,	32,	30,	32,	32,	32,	32,	32,	31	} },	
/*52*/		{ 6, { 33,	33,	33,	33,	33,	62,	32,	32,	32,	32,	32,	32	} },	
/*53*/		{ 6, { 62,	1,	1,	1,	1,	30,	32,	32,	32,	32,	32,	31	} },	
/*54*/		{ 6, { 62,	1,	1,	1,	1,	31,	33,	33,	33,	33,	33,	30	} },	
/*55*/		{ 6, { 63,	32,	16,	8,	4,	2,	1,	1,	1,	1,	1,	1	} },	
/*56*/		{ 6, { 30,	33,	33,	33,	33,	30,	33,	33,	33,	33,	33,	30	} },	
/*57*/		{ 6, { 30,	33,	33,	33,	33,	30,	32,	32,	32,	32,	32,	30	} },	
/*58*/		{ 1, { 0,	1,	0,	0,	0,	0,	0,	0,	0,	0,	1,	0	} },	
/*59*/		{ 3, { 0,	0,	4,	0,	0,	4,	4,	2,	0,	0,	0,	0	} },	
/*60*/		{ 6, { 0,	36,	18,	9,	18,	36,	0,	0,	0,	0,	0,	0	} },	
/*61*/		{ 3, { 0,	0,	7,	0,	7,	0,	0,	0,	0,	0,	0,	0	} },	
/*62*/		{ 6, { 0,	9,	18,	36,	18,	9,	0,	0,	0,	0,	0,	0	} },	
/*63*/		{ 5, { 0,	14,	17,	8,	4,	0,	4,	0,	0,	0,	0,	0	} },	
/*64*/		{ 4, { 9,	0,	15,	9,	15,	1,	15,	0,	0,	0,	0,	0	} },	
/*65*/		{ 7, { 120,	68,	66,	65,	65,	65,	127,	65,	65,	65,	65,	65	} },	
/*66*/		{ 7, { 63,	65,	65,	65,	65,	63,	65,	65,	65,	65,	65,	63	} },	
/*67*/		{ 6, { 30,	33,	1,	1,	1,	1,	1,	1,	1,	1,	33,	30	} },	
/*68*/		{ 7, { 31,	33,	65,	65,	65,	65,	65,	65,	65,	65,	33,	31	} },	
/*69*/		{ 6, { 63,	1,	1,	1,	1,	15,	1,	1,	1,	1,	1,	63	} },	
/*70*/		{ 6, { 63,	1,	1,	1,	1,	31,	1,	1,	1,	1,	1,	1	} },	
/*71*/		{ 5, { 14,	17,	1,	1,	25,	17,	14,	0,	0,	0,	0,	0	} },	
/*72*/		{ 7, { 65,	65,	65,	65,	65,	127,	65,	65,	65,	65,	65,	65	} },	
/*73*/		{ 5, { 31,	4,	4,	4,	4,	4,	31,	0,	0,	0,	0,	0	} },	
/*74*/		{ 4, { 8,	8,	8,	8,	9,	9,	6,	0,	0,	0,	0,	0	} },	
/*75*/		{ 6, { 33,	33,	17,	9,	5,	3,	3,	5,	9,	17,	33,	33	} },	
/*76*/		{ 4, { 1,	1,	1,	1,	1,	9,	15,	0,	0,	0,	0,	0	} },	
/*77*/		{ 5, { 17,	27,	21,	17,	17,	17,	17,	0,	0,	0,	0,	0	} },	
/*78*/		{ 5, { 17,	17,	19,	21,	21,	25,	17,	0,	0,	0,	0,	0	} },	
/*79*/		{ 6, { 30,	33,	33,	33,	33,	33,	33,	33,	33,	33,	33,	30	} },	
/*80*/		{ 5, { 15,	17,	17,	17,	15,	1,	1,	0,	0,	0,	0,	0	} },	
/*81*/		{ 5, { 14,	17,	17,	17,	21,	9,	22,	0,	0,	0,	0,	0	} },	
/*82*/		{ 5, { 15,	17,	17,	17,	15,	9,	17,	0,	0,	0,	0,	0	} },	
/*83*/		{ 4, { 15,	1,	1,	15,	8,	8,	15,	0,	0,	0,	0,	0	} },	
/*84*/		{ 7, { 127,	8,	8,	8,	8,	8,	8,	8,	8,	8,	8,	8	} },	
/*85*/		{ 5, { 17,	17,	17,	17,	17,	17,	14,	0,	0,	0,	0,	0	} },	
/*86*/		{ 5, { 17,	17,	17,	17,	17,	10,	4,	0,	0,	0,	0,	0	} },	
/*87*/		{ 5, { 17,	17,	17,	17,	17,	21,	10,	0,	0,	0,	0,	0	} },	
/*88*/		{ 6, { 33,	33,	18,	18,	12,	12,	12,	12,	18,	18,	33,	33	} },	
/*89*/		{ 7, { 65,	65,	34,	34,	20,	20,	8,	8,	8,	8,	8,	8	} },	
/*90*/		{ 7, { 127,	64,	64,	32,	16,	8,	4,	2,	1,	1,	1,	127	} },	
/*91*/		{ 4, { 0,	14,	2,	2,	2,	2,	14,	0,	0,	0,	0,	0	} },	
/*92*/		{ 5, { 0,	0,	1,	2,	4,	8,	16,	0,	0,	0,	0,	0	} },	
/*93*/		{ 4, { 0,	14,	8,	8,	8,	8,	14,	0,	0,	0,	0,	0	} },	
/*94*/		{ 5, { 0,	4,	14,	21,	4,	4,	4,	0,	0,	0,	0,	0	} },	
/*95*/		{ 6, { 0,	0,	0,	0,	0,	0,	0,	63,	0,	0,	0,	0	} },	
/*96*/		{ 3, { 6,	2,	7,	2,	2,	2,	2,	0,	0,	0,	0,	0	} },	
/*97*/		{ 4, { 0,	0,	15,	8,	15,	9,	15,	0,	0,	0,	0,	0	} },	
/*98*/		{ 4, { 1,	1,	15,	9,	9,	9,	15,	0,	0,	0,	0,	0	} },	
/*99*/		{ 4, { 0,	0,	15,	1,	1,	1,	15,	0,	0,	0,	0,	0	} },	
/*100*/		{ 4, { 8,	8,	15,	9,	9,	9,	15,	0,	0,	0,	0,	0	} },	
/*101*/		{ 4, { 0,	0,	15,	9,	15,	1,	15,	0,	0,	0,	0,	0	} },	
/*102*/		{ 3, { 6,	2,	7,	2,	2,	2,	2,	0,	0,	0,	0,	0	} },	
/*103*/		{ 4, { 0,	0,	15,	9,	9,	15,	8,	15,	0,	0,	0,	0	} },	
/*104*/		{ 4, { 1,	1,	15,	9,	9,	9,	9,	0,	0,	0,	0,	0	} },	
/*105*/		{ 1, { 1,	0,	1,	1,	1,	1,	1,	0,	0,	0,	0,	0	} },	
/*106*/		{ 4, { 0,	8,	0,	8,	8,	8,	9,	6,	0,	0,	0,	0	} },	
/*107*/		{ 4, { 1,	1,	9,	5,	3,	5,	9,	0,	0,	0,	0,	0	} },	
/*108*/		{ 2, { 1,	1,	1,	1,	1,	1,	3,	0,	0,	0,	0,	0	} },	
/*109*/		{ 5, { 0,	0,	11,	21,	21,	21,	21,	0,	0,	0,	0,	0	} },	
/*110*/		{ 4, { 0,	0,	7,	9,	9,	9,	9,	0,	0,	0,	0,	0	} },	
/*111*/		{ 4, { 0,	0,	15,	9,	9,	9,	15,	0,	0,	0,	0,	0	} },	
/*112*/		{ 4, { 0,	0,	15,	9,	9,	15,	1,	1,	0,	0,	0,	0	} },	
/*113*/		{ 5, { 0,	0,	15,	9,	9,	15,	8,	24,	0,	0,	0,	0	} },	
/*114*/		{ 3, { 0,	0,	7,	1,	1,	1,	1,	0,	0,	0,	0,	0	} },	
/*115*/		{ 4, { 0,	0,	15,	1,	15,	8,	15,	0,	0,	0,	0,	0	} },	
/*116*/		{ 3, { 2,	2,	7,	2,	2,	2,	6,	0,	0,	0,	0,	0	} },	
/*117*/		{ 4, { 0,	0,	9,	9,	9,	9,	15,	0,	0,	0,	0,	0	} },	
/*118*/		{ 5, { 0,	0,	17,	17,	10,	10,	4,	0,	0,	0,	0,	0	} },	
/*119*/		{ 5, { 0,	0,	17,	21,	21,	21,	10,	0,	0,	0,	0,	0	} },	
/*120*/		{ 5, { 0,	0,	17,	10,	4,	10,	17,	0,	0,	0,	0,	0	} },	
/*121*/		{ 4, { 0,	0,	9,	9,	9,	15,	8,	15,	0,	0,	0,	0	} },	
/*122*/		{ 5, { 0,	0,	31,	8,	4,	2,	31,	0,	0,	0,	0,	0	} },	
/*123*/		{ 0, { 0,	0,	0,	0,	0,	0,	0,	0,	0,	0,	0,	0	} },	
/*124*/		{ 0, { 0,	0,	0,	0,	0,	0,	0,	0,	0,	0,	0,	0	} },	
/*125*/		{ 0, { 0,	0,	0,	0,	0,	0,	0,	0,	0,	0,	0,	0	} },	
/*126*/		{ 0, { 0,	0,	0,	0,	0,	0,	0,	0,	0,	0,	0,	0	} },	
/*127*/		{ 0, { 0,	0,	0,	0,	0,	0,	0,	0,	0,	0,	0,	0	} },	
/*128*/		{ 9, { 16,	56,	84,	146,	273,	16,	16,	16,	16,	16,	16,	16	} },	
/*129*/		{ 9, { 16,	16,	16,	16,	16,	16,	16,	273,	146,	84,	56,	16	} },	
/*130*/		{ 9, { 511,	254,	124,	56,	16,	0,	0,	0,	0,	0,	0,	0	} },	
/*131*/		{ 9, { 16,	56,	124,	254,	511,	0,	0,	0,	0,	0,	0,	0	} },	
/*132*/		{ 9, { 257,	130,	68,	40,	16,	40,	68,	130,	257,	0,	0,	0	} },	
/*133*/		{ 10, { 0,	0,	0,	0,	0,	1,	2,	4,	520,	272,	160,	64	} },	
/*134*/		{ 8, { 128,	64,	32,	16,	8,	4,	2,	1,	0,	0,	0,	0	} },	
/*135*/		{ 9, { 256,	256,	128,	128,	65,	65,	34,	34,	20,	20,	8,	8	} },	
/*136*/		{ 0, { 0,	0,	0,	0,	0,	0,	0,	0,	0,	0,	0,	0	} },	
/*137*/		{ 0, { 0,	0,	0,	0,	0,	0,	0,	0,	0,	0,	0,	0	} },	
/*138*/		{ 0, { 0,	0,	0,	0,	0,	0,	0,	0,	0,	0,	0,	0	} },	
/*139*/		{ 0, { 0,	0,	0,	0,	0,	0,	0,	0,	0,	0,	0,	0	} },	
/*140*/		{ 0, { 0,	0,	0,	0,	0,	0,	0,	0,	0,	0,	0,	0	} },	
/*141*/		{ 0, { 0,	0,	0,	0,	0,	0,	0,	0,	0,	0,	0,	0	} },	
/*142*/		{ 0, { 0,	0,	0,	0,	0,	0,	0,	0,	0,	0,	0,	0	} },	
/*143*/		{ 0, { 0,	0,	0,	0,	0,	0,	0,	0,	0,	0,	0,	0	} },	
/*144*/		{ 0, { 0,	0,	0,	0,	0,	0,	0,	0,	0,	0,	0,	0	} },	
/*145*/		{ 0, { 0,	0,	0,	0,	0,	0,	0,	0,	0,	0,	0,	0	} },	
/*146*/		{ 0, { 0,	0,	0,	0,	0,	0,	0,	0,	0,	0,	0,	0	} },	
/*147*/		{ 0, { 0,	0,	0,	0,	0,	0,	0,	0,	0,	0,	0,	0	} },	
/*148*/		{ 0, { 0,	0,	0,	0,	0,	0,	0,	0,	0,	0,	0,	0	} },	
/*149*/		{ 0, { 0,	0,	0,	0,	0,	0,	0,	0,	0,	0,	0,	0	} },	
/*150*/		{ 0, { 0,	0,	0,	0,	0,	0,	0,	0,	0,	0,	0,	0	} },	
/*151*/		{ 0, { 0,	0,	0,	0,	0,	0,	0,	0,	0,	0,	0,	0	} },	
/*152*/		{ 0, { 0,	0,	0,	0,	0,	0,	0,	0,	0,	0,	0,	0	} },	
/*153*/		{ 0, { 0,	0,	0,	0,	0,	0,	0,	0,	0,	0,	0,	0	} },	
/*154*/		{ 0, { 0,	0,	0,	0,	0,	0,	0,	0,	0,	0,	0,	0	} },	
/*155*/		{ 0, { 0,	0,	0,	0,	0,	0,	0,	0,	0,	0,	0,	0	} },	
/*156*/		{ 0, { 0,	0,	0,	0,	0,	0,	0,	0,	0,	0,	0,	0	} },	
/*157*/		{ 0, { 0,	0,	0,	0,	0,	0,	0,	0,	0,	0,	0,	0	} },	
/*158*/		{ 0, { 0,	0,	0,	0,	0,	0,	0,	0,	0,	0,	0,	0	} },	
/*159*/		{ 0, { 0,	0,	0,	0,	0,	0,	0,	0,	0,	0,	0,	0	} },	
/*160*/		{ 0, { 0,	0,	0,	0,	0,	0,	0,	0,	0,	0,	0,	0	} },	
/*161*/		{ 0, { 0,	0,	0,	0,	0,	0,	0,	0,	0,	0,	0,	0	} },	
/*162*/		{ 0, { 0,	0,	0,	0,	0,	0,	0,	0,	0,	0,	0,	0	} },	
/*163*/		{ 0, { 0,	0,	0,	0,	0,	0,	0,	0,	0,	0,	0,	0	} },	
/*164*/		{ 0, { 0,	0,	0,	0,	0,	0,	0,	0,	0,	0,	0,	0	} },	
/*165*/		{ 1, { 0,	1,	0,	0,	0,	0,	0,	0,	0,	1,	0,	0	} },	
/*166*/		{ 0, { 0,	0,	0,	0,	0,	0,	0,	0,	0,	0,	0,	0	} },	
/*167*/		{ 0, { 0,	0,	0,	0,	0,	0,	0,	0,	0,	0,	0,	0	} },	
/*168*/		{ 4, { 6,	9,	9,	6,	0,	0,	0,	0,	0,	0,	0,	0	} },	
/*169*/		{ 0, { 0,	0,	0,	0,	0,	0,	0,	0,	0,	0,	0,	0	} },	
/*170*/		{ 0, { 0,	0,	0,	0,	0,	0,	0,	0,	0,	0,	0,	0	} },	
/*171*/		{ 0, { 0,	0,	0,	0,	0,	0,	0,	0,	0,	0,	0,	0	} },	
/*172*/		{ 0, { 0,	0,	0,	0,	0,	0,	0,	0,	0,	0,	0,	0	} },	
/*173*/		{ 0, { 0,	0,	0,	0,	0,	0,	0,	0,	0,	0,	0,	0	} },	
/*174*/		{ 0, { 0,	0,	0,	0,	0,	0,	0,	0,	0,	0,	0,	0	} },	
/*175*/		{ 0, { 0,	0,	0,	0,	0,	0,	0,	0,	0,	0,	0,	0	} },	
/*176*/		{ 0, { 0,	0,	0,	0,	0,	0,	0,	0,	0,	0,	0,	0	} },	
/*177*/		{ 0, { 0,	0,	0,	0,	0,	0,	0,	0,	0,	0,	0,	0	} },	
/*178*/		{ 0, { 0,	0,	0,	0,	0,	0,	0,	0,	0,	0,	0,	0	} },	
/*179*/		{ 0, { 0,	0,	0,	0,	0,	0,	0,	0,	0,	0,	0,	0	} },	
/*180*/		{ 0, { 0,	0,	0,	0,	0,	0,	0,	0,	0,	0,	0,	0	} },	
/*181*/		{ 0, { 0,	0,	0,	0,	0,	0,	0,	0,	0,	0,	0,	0	} },	
/*182*/		{ 0, { 0,	0,	0,	0,	0,	0,	0,	0,	0,	0,	0,	0	} },	
/*183*/		{ 0, { 0,	0,	0,	0,	0,	0,	0,	0,	0,	0,	0,	0	} },	
/*184*/		{ 0, { 0,	0,	0,	0,	0,	0,	0,	0,	0,	0,	0,	0	} },	
/*185*/		{ 0, { 0,	0,	0,	0,	0,	0,	0,	0,	0,	0,	0,	0	} },	
/*186*/		{ 0, { 0,	0,	0,	0,	0,	0,	0,	0,	0,	0,	0,	0	} },	
/*187*/		{ 0, { 0,	0,	0,	0,	0,	0,	0,	0,	0,	0,	0,	0	} },	
/*188*/		{ 0, { 0,	0,	0,	0,	0,	0,	0,	0,	0,	0,	0,	0	} },	
/*189*/		{ 0, { 0,	0,	0,	0,	0,	0,	0,	0,	0,	0,	0,	0	} },	
/*190*/		{ 0, { 0,	0,	0,	0,	0,	0,	0,	0,	0,	0,	0,	0	} },	
/*191*/		{ 0, { 0,	0,	0,	0,	0,	0,	0,	0,	0,	0,	0,	0	} },	
/*192*/		{ 7, { 60,	66,	65,	65,	65,	65,	127,	65,	65,	65,	65,	65	} },	
/*193*/		{ 7, { 63,	1,	1,	1,	1,	63,	65,	65,	65,	65,	65,	63	} },	
/*194*/		{ 6, { 15,	17,	17,	17,	17,	17,	31,	33,	33,	33,	33,	31	} },	
/*195*/		{ 6, { 63,	1,	1,	1,	1,	1,	1,	1,	1,	1,	1,	1	} },	
/*196*/		{ 10, { 112,	152,	136,	132,	132,	132,	132,	132,	132,	510,	513,	513	} },	
/*197*/		{ 5, { 30,	1,	1,	1,	1,	14,	1,	1,	1,	1,	1,	30	} },	
/*198*/		{ 7, { 73,	73,	73,	73,	42,	28,	42,	73,	73,	73,	73,	73	} },	
/*199*/		{ 6, { 30,	33,	32,	32,	16,	28,	16,	32,	32,	32,	33,	30	} },	
/*200*/		{ 7, { 65,	97,	97,	81,	81,	73,	73,	69,	69,	67,	67,	65	} },	
/*201*/		{ 7, { 73,	97,	97,	81,	81,	73,	73,	69,	69,	67,	67,	65	} },	
/*202*/		{ 6, { 33,	33,	17,	9,	5,	3,	3,	5,	9,	17,	33,	33	} },	
/*203*/		{ 6, { 28,	34,	34,	33,	33,	33,	33,	33,	33,	33,	33,	33	} },	
/*204*/		{ 8, { 129,	195,	165,	153,	129,	129,	129,	129,	129,	129,	129,	129	} },	
/*205*/		{ 6, { 33,	33,	33,	33,	33,	63,	33,	33,	33,	33,	33,	33	} },	
/*206*/		{ 6, { 30,	33,	33,	33,	33,	33,	33,	33,	33,	33,	33,	30	} },	
/*207*/		{ 7, { 127,	65,	65,	65,	65,	65,	65,	65,	65,	65,	65,	65	} },	
/*208*/		{ 7, { 63,	65,	65,	65,	65,	65,	63,	1,	1,	1,	1,	1	} },	
/*209*/		{ 6, { 30,	33,	1,	1,	1,	1,	1,	1,	1,	1,	33,	30	} },	
/*210*/		{ 7, { 127,	8,	8,	8,	8,	8,	8,	8,	8,	8,	8,	8	} },	
/*211*/		{ 7, { 65,	65,	65,	65,	65,	65,	126,	64,	64,	64,	64,	63	} },	
/*212*/		{ 9, { 254,	273,	273,	273,	273,	273,	273,	273,	254,	16,	16,	16	} },	
/*213*/		{ 6, { 33,	33,	18,	18,	12,	12,	12,	12,	18,	18,	33,	33	} },	
/*214*/		{ 9, { 65,	65,	65,	65,	65,	65,	65,	65,	65,	65,	65,	511	} },	
/*215*/		{ 7, { 65,	65,	65,	65,	65,	65,	65,	126,	64,	64,	64,	64	} },	
/*216*/		{ 9, { 257,	257,	273,	273,	273,	273,	273,	273,	273,	273,	273,	254	} },	
/*217*/		{ 10, { 257,	257,	273,	273,	273,	273,	273,	273,	273,	273,	273,	1022	} },	
/*218*/		{ 7, { 3,	2,	2,	2,	2,	62,	66,	66,	66,	66,	66,	60	} },	
/*219*/		{ 8, { 129,	129,	129,	129,	129,	159,	161,	161,	161,	161,	161,	158	} },	
/*220*/		{ 6, { 1,	1,	1,	1,	1,	31,	33,	33,	33,	33,	33,	30	} },	
/*221*/		{ 7, { 63,	64,	64,	64,	64,	124,	64,	64,	64,	64,	64,	63	} },	
/*222*/		{ 9, { 241,	265,	265,	265,	265,	271,	265,	265,	265,	265,	265,	241	} },	
/*223*/		{ 7, { 126,	65,	65,	65,	65,	65,	126,	80,	72,	68,	66,	65	} },	
/*224*/		{ 5, { 0,	0,	0,	0,	0,	14,	16,	16,	30,	17,	17,	30	} },	
/*225*/		{ 5, { 0,	0,	0,	0,	0,	31,	1,	1,	15,	17,	17,	15	} },	
/*226*/		{ 5, { 0,	0,	0,	0,	0,	15,	17,	17,	15,	17,	17,	15	} },	
/*227*/		{ 5, { 0,	0,	0,	0,	0,	31,	1,	1,	1,	1,	1,	1	} },	
/*228*/		{ 7, { 0,	0,	0,	0,	0,	60,	34,	34,	34,	34,	127,	65	} },	
/*229*/		{ 5, { 0,	0,	0,	0,	0,	14,	17,	17,	15,	1,	1,	30	} },	
/*230*/		{ 5, { 0,	0,	0,	0,	0,	21,	21,	21,	14,	21,	21,	21	} },	
/*231*/		{ 4, { 0,	0,	0,	0,	0,	7,	8,	8,	6,	8,	8,	7	} },	
/*232*/		{ 5, { 0,	0,	0,	0,	0,	17,	25,	21,	19,	17,	17,	17	} },	
/*233*/		{ 5, { 0,	0,	0,	0,	4,	17,	25,	21,	19,	17,	17,	17	} },	
/*234*/		{ 4, { 0,	0,	0,	0,	0,	9,	9,	5,	3,	5,	9,	9	} },	
/*235*/		{ 5, { 0,	0,	0,	0,	0,	28,	18,	17,	17,	17,	17,	17	} },	
/*236*/		{ 5, { 0,	0,	0,	0,	0,	17,	27,	21,	17,	17,	17,	17	} },	
/*237*/		{ 5, { 0,	0,	0,	0,	0,	17,	17,	17,	31,	17,	17,	17	} },	
/*238*/		{ 5, { 0,	0,	0,	0,	0,	14,	17,	17,	17,	17,	17,	14	} },	
/*239*/		{ 5, { 0,	0,	0,	0,	0,	31,	17,	17,	17,	17,	17,	17	} },	
/*240*/		{ 4, { 0,	0,	0,	0,	0,	6,	9,	9,	7,	1,	1,	1	} },	
/*241*/		{ 4, { 0,	0,	0,	0,	0,	15,	1,	1,	1,	1,	1,	15	} },	
/*242*/		{ 5, { 0,	0,	0,	0,	0,	31,	4,	4,	4,	4,	4,	4	} },	
/*243*/		{ 5, { 0,	0,	0,	0,	0,	17,	17,	17,	31,	16,	16,	31	} },	
/*244*/		{ 5, { 0,	0,	0,	0,	0,	31,	21,	21,	31,	4,	4,	4	} },	
/*245*/		{ 7, { 0,	0,	0,	0,	0,	65,	34,	20,	8,	20,	34,	65	} },	
/*246*/		{ 6, { 0,	0,	0,	0,	0,	17,	17,	17,	17,	17,	17,	63	} },	
/*247*/		{ 5, { 0,	0,	0,	0,	0,	17,	17,	17,	30,	16,	16,	16	} },	
/*248*/		{ 7, { 0,	0,	0,	0,	0,	65,	73,	73,	73,	73,	73,	127	} },	
/*249*/		{ 8, { 0,	0,	0,	0,	0,	65,	73,	73,	73,	73,	73,	255	} },	
/*250*/		{ 5, { 0,	0,	0,	0,	0,	3,	2,	2,	14,	18,	18,	14	} },	
/*251*/		{ 6, { 0,	0,	0,	0,	0,	33,	33,	33,	39,	41,	41,	39	} },	
/*252*/		{ 4, { 0,	0,	0,	0,	0,	1,	1,	1,	7,	9,	9,	7	} },	
/*253*/		{ 4, { 0,	0,	0,	0,	0,	15,	8,	8,	14,	8,	8,	15	} },	
/*254*/		{ 6, { 0,	0,	0,	0,	0,	25,	37,	37,	39,	37,	37,	25	} },	
/*255*/		{ 5, { 0,	0,	0,	0,	0,	30,	17,	17,	30,	20,	18,	17	} }	
} };
