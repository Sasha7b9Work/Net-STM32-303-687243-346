#include "Font.h"
const Font8 font8 = {
	8, {
/*0*/		{ 0, { 0,	0,	0,	0,	0,	0,	0,	0	} },	
/*1*/		{ 0, { 0,	0,	0,	0,	0,	0,	0,	0	} },	
/*2*/		{ 0, { 0,	0,	0,	0,	0,	0,	0,	0	} },	
/*3*/		{ 0, { 0,	0,	0,	0,	0,	0,	0,	0	} },	
/*4*/		{ 0, { 0,	0,	0,	0,	0,	0,	0,	0	} },	
/*5*/		{ 0, { 0,	0,	0,	0,	0,	0,	0,	0	} },	
/*6*/		{ 0, { 0,	0,	0,	0,	0,	0,	0,	0	} },	
/*7*/		{ 0, { 0,	0,	0,	0,	0,	0,	0,	0	} },	
/*8*/		{ 0, { 0,	0,	0,	0,	0,	0,	0,	0	} },	
/*9*/		{ 0, { 0,	0,	0,	0,	0,	0,	0,	0	} },	
/*10*/		{ 0, { 0,	0,	0,	0,	0,	0,	0,	0	} },	
/*11*/		{ 0, { 0,	0,	0,	0,	0,	0,	0,	0	} },	
/*12*/		{ 0, { 0,	0,	0,	0,	0,	0,	0,	0	} },	
/*13*/		{ 5, { 32,	112,	248,	32,	32,	248,	112,	32	} },	
/*14*/		{ 8, { 62,	65,	160,	144,	136,	128,	128,	65	} },	
/*15*/		{ 1, { 0,	0,	128,	128,	128,	128,	128,	0	} },	
/*16*/		{ 0, { 0,	0,	0,	0,	0,	0,	0,	0	} },	
/*17*/		{ 1, { 0,	0,	0,	0,	0,	0,	0,	0	} },	
/*18*/		{ 2, { 0,	0,	0,	0,	0,	0,	0,	0	} },	
/*19*/		{ 3, { 0,	0,	0,	0,	0,	0,	0,	0	} },	
/*20*/		{ 4, { 0,	0,	0,	0,	0,	0,	0,	0	} },	
/*21*/		{ 5, { 0,	0,	0,	0,	0,	0,	0,	0	} },	
/*22*/		{ 6, { 0,	0,	0,	0,	0,	0,	0,	0	} },	
/*23*/		{ 7, { 0,	0,	0,	0,	0,	0,	0,	0	} },	
/*24*/		{ 8, { 0,	0,	0,	0,	0,	0,	0,	0	} },	
/*25*/		{ 9, { 0,	0,	0,	0,	0,	0,	0,	0	} },	
/*26*/		{ 10, { 0,	0,	0,	0,	0,	0,	0,	0	} },	
/*27*/		{ 11, { 0,	0,	0,	0,	0,	0,	0,	0	} },	
/*28*/		{ 12, { 0,	0,	0,	0,	0,	0,	0,	0	} },	
/*29*/		{ 13, { 0,	0,	0,	0,	0,	0,	0,	0	} },	
/*30*/		{ 14, { 62,	0,	0,	0,	0,	0,	0,	0	} },	
/*31*/		{ 15, { 0,	0,	0,	0,	0,	0,	0,	0	} },	
/*32*/		{ 2, { 0,	0,	0,	0,	0,	0,	0,	0	} },	
/*33*/		{ 3, { 32,	32,	32,	32,	32,	0,	32,	0	} },	
/*34*/		{ 3, { 160,	160,	0,	0,	0,	0,	0,	0	} },	
/*35*/		{ 5, { 0,	80,	248,	80,	80,	248,	80,	0	} },	
/*36*/		{ 5, { 0,	32,	248,	160,	248,	40,	248,	32	} },	
/*37*/		{ 6, { 0,	196,	200,	16,	32,	76,	140,	0	} },	
/*38*/		{ 5, { 0,	32,	80,	32,	88,	144,	104,	0	} },	
/*39*/		{ 3, { 0,	32,	64,	0,	0,	0,	0,	0	} },	
/*40*/		{ 2, { 64,	64,	128,	128,	128,	64,	64,	0	} },	
/*41*/		{ 2, { 128,	128,	64,	64,	64,	128,	128,	0	} },	
/*42*/		{ 3, { 0,	0,	160,	64,	160,	0,	0,	0	} },	
/*43*/		{ 3, { 0,	0,	64,	224,	64,	0,	0,	0	} },	
/*44*/		{ 4, { 0,	0,	0,	0,	0,	16,	32,	0	} },	
/*45*/		{ 3, { 0,	0,	0,	224,	0,	0,	0,	0	} },	
/*46*/		{ 1, { 0,	0,	0,	0,	0,	0,	128,	0	} },	
/*47*/		{ 3, { 0,	32,	32,	64,	64,	128,	128,	0	} },	
/*48*/		{ 4, { 240,	144,	144,	144,	144,	144,	240,	0	} },	
/*49*/		{ 4, { 96,	32,	32,	32,	32,	32,	112,	0	} },	
/*50*/		{ 4, { 240,	16,	16,	240,	128,	128,	240,	0	} },	
/*51*/		{ 4, { 240,	16,	16,	240,	16,	16,	240,	0	} },	
/*52*/		{ 4, { 144,	144,	144,	240,	16,	16,	16,	0	} },	
/*53*/		{ 4, { 240,	128,	128,	240,	16,	16,	240,	0	} },	
/*54*/		{ 4, { 240,	128,	128,	240,	144,	144,	240,	0	} },	
/*55*/		{ 4, { 240,	16,	32,	64,	128,	128,	128,	0	} },	
/*56*/		{ 4, { 240,	144,	144,	240,	144,	144,	240,	0	} },	
/*57*/		{ 4, { 240,	144,	144,	240,	16,	16,	240,	0	} },	
/*58*/		{ 1, { 0,	128,	0,	0,	0,	128,	0,	0	} },	
/*59*/		{ 3, { 0,	0,	32,	0,	0,	32,	32,	64	} },	
/*60*/		{ 6, { 0,	36,	72,	144,	72,	36,	0,	0	} },	
/*61*/		{ 3, { 0,	0,	224,	0,	224,	0,	0,	0	} },	
/*62*/		{ 6, { 0,	144,	72,	36,	72,	144,	0,	0	} },	
/*63*/		{ 5, { 0,	112,	136,	16,	32,	0,	32,	0	} },	
/*64*/		{ 4, { 144,	0,	240,	144,	240,	128,	240,	0	} },	
/*65*/		{ 4, { 240,	144,	144,	144,	240,	144,	144,	0	} },	
/*66*/		{ 4, { 224,	144,	144,	224,	144,	144,	224,	0	} },	
/*67*/		{ 4, { 240,	128,	128,	128,	128,	128,	240,	0	} },	
/*68*/		{ 4, { 224,	144,	144,	144,	144,	144,	224,	0	} },	
/*69*/		{ 4, { 240,	128,	128,	224,	128,	128,	240,	0	} },	
/*70*/		{ 4, { 240,	128,	128,	224,	128,	128,	128,	0	} },	
/*71*/		{ 5, { 112,	136,	128,	128,	152,	136,	112,	0	} },	
/*72*/		{ 5, { 136,	136,	136,	248,	136,	136,	136,	0	} },	
/*73*/		{ 5, { 248,	32,	32,	32,	32,	32,	248,	0	} },	
/*74*/		{ 4, { 16,	16,	16,	16,	144,	144,	96,	0	} },	
/*75*/		{ 5, { 136,	144,	160,	192,	160,	144,	136,	0	} },	
/*76*/		{ 4, { 128,	128,	128,	128,	128,	144,	240,	0	} },	
/*77*/		{ 5, { 136,	216,	168,	136,	136,	136,	136,	0	} },	
/*78*/		{ 5, { 136,	136,	200,	168,	168,	152,	136,	0	} },	
/*79*/		{ 5, { 112,	136,	136,	136,	136,	136,	112,	0	} },	
/*80*/		{ 5, { 240,	136,	136,	136,	240,	128,	128,	0	} },	
/*81*/		{ 5, { 112,	136,	136,	136,	168,	144,	104,	0	} },	
/*82*/		{ 5, { 240,	136,	136,	136,	240,	144,	136,	0	} },	
/*83*/		{ 4, { 240,	128,	128,	240,	16,	16,	240,	0	} },	
/*84*/		{ 5, { 248,	32,	32,	32,	32,	32,	32,	0	} },	
/*85*/		{ 5, { 136,	136,	136,	136,	136,	136,	112,	0	} },	
/*86*/		{ 5, { 136,	136,	136,	136,	136,	80,	32,	0	} },	
/*87*/		{ 5, { 136,	136,	136,	136,	136,	168,	80,	0	} },	
/*88*/		{ 5, { 136,	80,	32,	32,	32,	80,	136,	0	} },	
/*89*/		{ 5, { 136,	136,	136,	80,	32,	32,	32,	0	} },	
/*90*/		{ 5, { 248,	8,	16,	32,	64,	128,	248,	0	} },	
/*91*/		{ 4, { 0,	112,	64,	64,	64,	64,	112,	0	} },	
/*92*/		{ 5, { 0,	0,	128,	64,	32,	16,	8,	0	} },	
/*93*/		{ 4, { 0,	112,	16,	16,	16,	16,	112,	0	} },	
/*94*/		{ 5, { 0,	32,	112,	168,	32,	32,	32,	0	} },	
/*95*/		{ 6, { 0,	0,	0,	0,	0,	0,	0,	252	} },	
/*96*/		{ 3, { 96,	64,	224,	64,	64,	64,	64,	0	} },	
/*97*/		{ 4, { 0,	0,	240,	16,	240,	144,	240,	0	} },	
/*98*/		{ 4, { 128,	128,	240,	144,	144,	144,	240,	0	} },	
/*99*/		{ 4, { 0,	0,	240,	128,	128,	128,	240,	0	} },	
/*100*/		{ 4, { 16,	16,	240,	144,	144,	144,	240,	0	} },	
/*101*/		{ 4, { 0,	0,	240,	144,	240,	128,	240,	0	} },	
/*102*/		{ 3, { 96,	64,	224,	64,	64,	64,	64,	0	} },	
/*103*/		{ 4, { 0,	0,	240,	144,	144,	240,	16,	240	} },	
/*104*/		{ 4, { 128,	128,	240,	144,	144,	144,	144,	0	} },	
/*105*/		{ 1, { 128,	0,	128,	128,	128,	128,	128,	0	} },	
/*106*/		{ 4, { 0,	16,	0,	16,	16,	16,	144,	96	} },	
/*107*/		{ 4, { 128,	128,	144,	160,	192,	160,	144,	0	} },	
/*108*/		{ 2, { 128,	128,	128,	128,	128,	128,	192,	0	} },	
/*109*/		{ 5, { 0,	0,	208,	168,	168,	168,	168,	0	} },	
/*110*/		{ 4, { 0,	0,	224,	144,	144,	144,	144,	0	} },	
/*111*/		{ 4, { 0,	0,	240,	144,	144,	144,	240,	0	} },	
/*112*/		{ 4, { 0,	0,	240,	144,	144,	240,	128,	128	} },	
/*113*/		{ 5, { 0,	0,	240,	144,	144,	240,	16,	24	} },	
/*114*/		{ 3, { 0,	0,	224,	128,	128,	128,	128,	0	} },	
/*115*/		{ 4, { 0,	0,	240,	128,	240,	16,	240,	0	} },	
/*116*/		{ 3, { 64,	64,	224,	64,	64,	64,	96,	0	} },	
/*117*/		{ 4, { 0,	0,	144,	144,	144,	144,	240,	0	} },	
/*118*/		{ 5, { 0,	0,	136,	136,	80,	80,	32,	0	} },	
/*119*/		{ 5, { 0,	0,	136,	168,	168,	168,	80,	0	} },	
/*120*/		{ 5, { 0,	0,	136,	80,	32,	80,	136,	0	} },	
/*121*/		{ 4, { 0,	0,	144,	144,	144,	240,	16,	240	} },	
/*122*/		{ 5, { 0,	0,	248,	16,	32,	64,	248,	0	} },	
/*123*/		{ 7, { 248,	32,	32,	32,	32,	46,	42,	14	} },	
/*124*/		{ 7, { 240,	128,	128,	224,	128,	142,	132,	4	} },	
/*125*/		{ 7, { 248,	32,	32,	32,	32,	46,	36,	4	} },	
/*126*/		{ 7, { 0,	0,	96,	146,	12,	0,	0,	0	} },	
/*127*/		{ 2, { 0,	0,	64,	128,	128,	0,	0,	0	} },	
/*128*/		{ 3, { 0,	32,	96,	224,	96,	32,	0,	0	} },	
/*129*/		{ 3, { 0,	128,	192,	224,	192,	128,	0,	0	} },	
/*130*/		{ 8, { 240,	132,	140,	159,	140,	132,	240,	0	} },	
/*131*/		{ 8, { 225,	162,	228,	8,	16,	39,	69,	135	} },	
/*132*/		{ 6, { 124,	68,	108,	108,	56,	16,	0,	0	} },	
/*133*/		{ 7, { 254,	254,	254,	254,	124,	56,	16,	0	} },	
/*134*/		{ 8, { 0,	31,	49,	123,	59,	31,	0,	0	} },	
/*135*/		{ 7, { 0,	248,	140,	222,	220,	248,	0,	0	} },	
/*136*/		{ 7, { 130,	68,	40,	16,	40,	68,	130,	0	} },	
/*137*/		{ 0, { 0,	0,	0,	0,	0,	0,	0,	0	} },	
/*138*/		{ 6, { 124,	68,	84,	68,	124,	0,	0,	0	} },	
/*139*/		{ 7, { 254,	254,	254,	254,	254,	254,	0,	0	} },	
/*140*/		{ 8, { 62,	65,	128,	128,	136,	144,	160,	65	} },	
/*141*/		{ 1, { 0,	0,	128,	128,	128,	128,	128,	0	} },	
/*142*/		{ 5, { 224,	64,	64,	72,	88,	72,	72,	8	} },	
/*143*/		{ 6, { 224,	64,	64,	92,	84,	68,	72,	28	} },	
/*144*/		{ 7, { 0,	16,	16,	16,	16,	254,	0,	0	} },	
/*145*/		{ 7, { 0,	0,	96,	146,	12,	0,	0,	0	} },	
/*146*/		{ 7, { 0,	0,	254,	0,	214,	0,	0,	0	} },	
/*147*/		{ 8, { 248,	252,	254,	255,	254,	252,	248,	0	} },	
/*148*/		{ 8, { 31,	63,	127,	255,	127,	63,	31,	0	} },	
/*149*/		{ 5, { 248,	248,	248,	248,	248,	248,	248,	112	} },	
/*150*/		{ 5, { 112,	248,	248,	248,	248,	248,	248,	248	} },	
/*151*/		{ 8, { 0,	36,	102,	255,	102,	36,	0,	0	} },	
/*152*/		{ 0, { 0,	0,	0,	0,	0,	0,	0,	0	} },	
/*153*/		{ 6, { 0,	16,	8,	252,	8,	16,	0,	0	} },	
/*154*/		{ 5, { 0,	32,	32,	248,	32,	32,	0,	0	} },	
/*155*/		{ 5, { 0,	0,	0,	248,	0,	0,	0,	0	} },	
/*156*/		{ 7, { 62,	0,	0,	0,	0,	0,	0,	0	} },	
/*157*/		{ 0, { 0,	0,	0,	0,	0,	0,	0,	0	} },	
/*158*/		{ 6, { 160,	160,	160,	164,	172,	164,	196,	4	} },	
/*159*/		{ 7, { 160,	160,	160,	174,	170,	162,	196,	14	} },	
/*160*/		{ 7, { 40,	40,	42,	170,	130,	130,	66,	36	} },	
/*161*/		{ 8, { 24,	36,	66,	129,	0,	0,	0,	0	} },	
/*162*/		{ 8, { 0,	0,	0,	0,	129,	66,	36,	24	} },	
/*163*/		{ 5, { 32,	112,	248,	0,	0,	0,	0,	0	} },	
/*164*/		{ 5, { 248,	112,	32,	0,	0,	0,	0,	0	} },	
/*165*/		{ 1, { 0,	128,	0,	0,	0,	128,	0,	0	} },	
/*166*/		{ 7, { 240,	16,	16,	56,	16,	16,	30,	0	} },	
/*167*/		{ 7, { 30,	16,	16,	56,	16,	16,	240,	0	} },	
/*168*/		{ 4, { 96,	144,	144,	96,	0,	0,	0,	0	} },	
/*169*/		{ 0, { 0,	0,	0,	0,	0,	0,	0,	0	} },	
/*170*/		{ 8, { 62,	65,	130,	132,	136,	128,	128,	65	} },	
/*171*/		{ 1, { 0,	0,	128,	128,	128,	128,	128,	0	} },	
/*172*/		{ 8, { 62,	65,	128,	128,	136,	132,	130,	65	} },	
/*173*/		{ 1, { 0,	0,	128,	128,	128,	128,	128,	0	} },	
/*174*/		{ 8, { 192,	240,	252,	255,	255,	255,	255,	255	} },	
/*175*/		{ 8, { 0,	0,	0,	0,	192,	240,	252,	255	} },	
/*176*/		{ 7, { 64,	64,	64,	64,	64,	64,	254,	0	} },	
/*177*/		{ 8, { 21,	64,	0,	64,	0,	64,	255,	0	} },	
/*178*/		{ 8, { 124,	130,	130,	130,	130,	130,	1,	0	} },	
/*179*/		{ 8, { 62,	65,	65,	65,	65,	65,	128,	0	} },	
/*180*/		{ 8, { 168,	2,	0,	2,	0,	2,	255,	0	} },	
/*181*/		{ 8, { 63,	64,	64,	64,	64,	64,	128,	0	} },	
/*182*/		{ 8, { 252,	2,	2,	2,	2,	2,	1,	0	} },	
/*183*/		{ 7, { 84,	84,	84,	84,	84,	84,	254,	0	} },	
/*184*/		{ 4, { 144,	0,	240,	144,	240,	128,	240,	0	} },	
/*185*/		{ 0, { 0,	0,	0,	0,	0,	0,	0,	0	} },	
/*186*/		{ 7, { 62,	0,	0,	0,	0,	0,	0,	0	} },	
/*187*/		{ 0, { 0,	0,	0,	0,	0,	0,	0,	0	} },	
/*188*/		{ 7, { 62,	0,	0,	0,	0,	0,	0,	0	} },	
/*189*/		{ 0, { 0,	0,	0,	0,	0,	0,	0,	0	} },	
/*190*/		{ 8, { 255,	255,	255,	255,	252,	240,	192,	0	} },	
/*191*/		{ 6, { 252,	240,	192,	0,	0,	0,	0,	0	} },	
/*192*/		{ 5, { 248,	136,	136,	248,	136,	136,	136,	0	} },	
/*193*/		{ 5, { 248,	128,	128,	248,	136,	136,	248,	0	} },	
/*194*/		{ 5, { 248,	136,	136,	240,	136,	136,	248,	0	} },	
/*195*/		{ 5, { 248,	128,	128,	128,	128,	128,	128,	0	} },	
/*196*/		{ 6, { 120,	72,	72,	72,	72,	72,	252,	132	} },	
/*197*/		{ 5, { 248,	128,	128,	240,	128,	128,	248,	0	} },	
/*198*/		{ 5, { 168,	168,	168,	112,	168,	168,	168,	0	} },	
/*199*/		{ 5, { 248,	136,	8,	48,	8,	136,	248,	0	} },	
/*200*/		{ 5, { 136,	152,	168,	200,	136,	136,	136,	0	} },	
/*201*/		{ 5, { 168,	152,	168,	200,	136,	136,	136,	0	} },	
/*202*/		{ 5, { 136,	144,	160,	192,	160,	144,	136,	0	} },	
/*203*/		{ 5, { 56,	72,	136,	136,	136,	136,	136,	0	} },	
/*204*/		{ 5, { 136,	216,	168,	136,	136,	136,	136,	0	} },	
/*205*/		{ 5, { 136,	136,	136,	248,	136,	136,	136,	0	} },	
/*206*/		{ 5, { 248,	136,	136,	136,	136,	136,	248,	0	} },	
/*207*/		{ 5, { 248,	136,	136,	136,	136,	136,	136,	0	} },	
/*208*/		{ 5, { 248,	136,	136,	136,	248,	128,	128,	0	} },	
/*209*/		{ 5, { 248,	136,	128,	128,	128,	136,	248,	0	} },	
/*210*/		{ 5, { 248,	32,	32,	32,	32,	32,	32,	0	} },	
/*211*/		{ 5, { 136,	136,	136,	248,	8,	8,	248,	0	} },	
/*212*/		{ 7, { 254,	146,	146,	146,	254,	16,	16,	0	} },	
/*213*/		{ 5, { 136,	80,	80,	32,	80,	80,	136,	0	} },	
/*214*/		{ 6, { 136,	136,	136,	136,	136,	136,	252,	4	} },	
/*215*/		{ 5, { 136,	136,	136,	136,	248,	8,	8,	0	} },	
/*216*/		{ 5, { 168,	168,	168,	168,	168,	168,	248,	0	} },	
/*217*/		{ 6, { 168,	168,	168,	168,	168,	168,	252,	4	} },	
/*218*/		{ 5, { 192,	64,	64,	120,	72,	72,	120,	0	} },	
/*219*/		{ 6, { 132,	132,	132,	244,	148,	148,	244,	0	} },	
/*220*/		{ 4, { 128,	128,	128,	240,	144,	144,	240,	0	} },	
/*221*/		{ 5, { 248,	8,	8,	248,	8,	8,	248,	0	} },	
/*222*/		{ 6, { 188,	164,	164,	228,	164,	164,	188,	0	} },	
/*223*/		{ 5, { 248,	136,	136,	136,	120,	72,	136,	0	} },	
/*224*/		{ 4, { 0,	0,	240,	16,	240,	144,	240,	0	} },	
/*225*/		{ 4, { 0,	0,	240,	128,	240,	144,	240,	0	} },	
/*226*/		{ 4, { 0,	0,	240,	144,	224,	144,	240,	0	} },	
/*227*/		{ 4, { 0,	0,	240,	128,	128,	128,	128,	0	} },	
/*228*/		{ 5, { 0,	0,	112,	80,	80,	248,	136,	0	} },	
/*229*/		{ 4, { 0,	0,	240,	144,	240,	128,	240,	0	} },	
/*230*/		{ 5, { 0,	0,	168,	168,	112,	168,	168,	0	} },	
/*231*/		{ 4, { 0,	0,	240,	144,	32,	144,	240,	0	} },	
/*232*/		{ 4, { 0,	0,	144,	176,	208,	144,	144,	0	} },	
/*233*/		{ 4, { 0,	32,	144,	176,	208,	144,	144,	0	} },	
/*234*/		{ 4, { 0,	0,	144,	160,	192,	160,	144,	0	} },	
/*235*/		{ 4, { 0,	0,	112,	144,	144,	144,	144,	0	} },	
/*236*/		{ 5, { 0,	0,	136,	216,	168,	136,	136,	0	} },	
/*237*/		{ 4, { 0,	0,	144,	144,	240,	144,	144,	0	} },	
/*238*/		{ 4, { 0,	0,	240,	144,	144,	144,	240,	0	} },	
/*239*/		{ 4, { 0,	0,	240,	144,	144,	144,	144,	0	} },	
/*240*/		{ 4, { 0,	0,	240,	144,	144,	240,	128,	128	} },	
/*241*/		{ 4, { 0,	0,	240,	144,	128,	144,	240,	0	} },	
/*242*/		{ 3, { 0,	0,	224,	64,	64,	64,	64,	0	} },	
/*243*/		{ 4, { 0,	0,	144,	144,	240,	16,	240,	0	} },	
/*244*/		{ 5, { 0,	0,	248,	168,	168,	248,	32,	0	} },	
/*245*/		{ 5, { 0,	0,	136,	80,	32,	80,	136,	0	} },	
/*246*/		{ 5, { 0,	0,	144,	144,	144,	144,	248,	8	} },	
/*247*/		{ 4, { 0,	0,	144,	144,	240,	16,	16,	0	} },	
/*248*/		{ 5, { 0,	0,	168,	168,	168,	168,	248,	0	} },	
/*249*/		{ 6, { 0,	0,	168,	168,	168,	168,	252,	4	} },	
/*250*/		{ 5, { 0,	0,	192,	64,	120,	72,	120,	0	} },	
/*251*/		{ 5, { 0,	0,	136,	136,	232,	168,	232,	0	} },	
/*252*/		{ 4, { 0,	0,	128,	128,	240,	144,	240,	0	} },	
/*253*/		{ 4, { 0,	0,	240,	16,	240,	16,	240,	0	} },	
/*254*/		{ 5, { 0,	0,	184,	168,	232,	168,	184,	0	} },	
/*255*/		{ 4, { 0,	0,	240,	144,	112,	80,	144,	0	} }	
} };
